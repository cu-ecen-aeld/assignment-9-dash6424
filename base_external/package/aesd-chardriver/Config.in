## base_external/package/aesd-chardriver/Config.in
```kconfig
config BR2_PACKAGE_AESD_CHARDRIVER
	bool "aesd-chardriver"
	help
	  Circular buffer implementation driver module
```

## base_external/package/ldd/Config.in
```kconfig
config BR2_PACKAGE_LDD
	bool "ldd"
	help
	  Include the misc-moudles and scull components in the kernel image.
	  Used to understand buildroot external trees and package builds.
```
